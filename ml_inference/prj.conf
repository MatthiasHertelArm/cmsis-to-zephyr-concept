## CMakeLists.txt
```
# SPDX-License-Identifier: Apache-2.0

cmake_minimum_required(VERSION 3.20.0)

# Add CMSIS-Pack middleware components as a Zephyr external module.
# The module in cmsis-pack-modules/executorch-ml/ is generated from
# cmsis-ai/ML.clayer.yml. Sources reference files in the ExecuTorch pack.
list(APPEND ZEPHYR_EXTRA_MODULES
  ${CMAKE_CURRENT_SOURCE_DIR}/../cmsis-pack-modules/executorch
  ${CMAKE_CURRENT_SOURCE_DIR}/../cmsis-pack-modules/model1
  ${CMAKE_CURRENT_SOURCE_DIR}/../cmsis-pack-modules/model2
)

find_package(Zephyr REQUIRED HINTS $ENV{ZEPHYR_BASE})
project(ml_inference)

target_sources(app PRIVATE src/main.cpp)

# Model data is included via model_pte.h from cmsis-ai/model/
target_include_directories(app PRIVATE ${CMAKE_CURRENT_SOURCE_DIR}/../cmsis-ai/model)
```

## sample.yaml
```
sample:
  description: ML inference using LiteRT from CMSIS-Packs
  name: ml_inference
  platforms:
    - mps3/corstone320/an557
common:
  tags: ml executorch cmsis-pack
  depends_on: cpp
```

## prj.conf
```kconfig
# Enable C++ (required by ExecuTorch)
CONFIG_CPP=y
CONFIG_STD_CPP17=y
CONFIG_REQUIRES_FULL_LIBCPP=y

# CMSIS-Pack ML components (from generated Kconfig)
CONFIG_CMSIS_EXECUTORCH_ML=y

# Disable backends that require NPU/CMSIS-NN hardware not on B-L475-IOT01A
CONFIG_CMSIS_EXECUTORCH_BACKEND_ETHOSU=n
CONFIG_CMSIS_EXECUTORCH_BACKEND_CORTEXM=y

# Stack/heap for ML workload
CONFIG_MAIN_STACK_SIZE=8192
CONFIG_HEAP_MEM_POOL_SIZE=32768

# Logging
CONFIG_LOG=y
CONFIG_PRINTK=y

# Use Newlib from the Arm GNU Toolchain
CONFIG_NEWLIB_LIBC=y
CONFIG_PICOLIBC=n
CONFIG_PICOLIBC_USE_MODULE=n
CONFIG_MINIMAL_LIBC=n
```

## src/main.cpp
```c
/*
 * Copyright (c) 2026 Arm Limited
 * SPDX-License-Identifier: Apache-2.0
 *
 * Minimal ML inference example using ExecuTorch from CMSIS-Packs.
 *
 * The CMSIS-Pack components (ExecuTorch runtime, Ethos-U backend, Cortex-M
 * backend) are delivered as a Zephyr external module generated from
 * cmsis-ai/ML.clayer.yml. See cmsis-pack-modules/executorch-ml/.
 */

#include <stdio.h>
#include <zephyr/kernel.h>

#include <executorch/extension/data_loader/buffer_data_loader.h>
#include <executorch/runtime/executor/program.h>
#include <executorch/runtime/executor/method.h>
#include <executorch/runtime/executor/method_meta.h>
#include <executorch/runtime/platform/runtime.h>

/* Model data — ExecuTorch .pte embedded as a C array */
#include "model_pte.h"

using executorch::extension::BufferDataLoader;
using executorch::runtime::Program;
using executorch::runtime::Result;
using executorch::runtime::Error;
using executorch::runtime::MethodMeta;
using executorch::runtime::Method;

int main(void)
{
    printf("ML Inference Example (ExecuTorch from CMSIS-Pack)\n");

    /* Initialise the ExecuTorch runtime */
    executorch::runtime::runtime_init();

    /* Create a data loader that reads from the in-memory PTE blob */
    BufferDataLoader loader(model_pte, sizeof(model_pte));

    /* Load the ExecuTorch program */
    Result<Program> program_result = Program::load(&loader);
    if (!program_result.ok()) {
        printf("Program::load() failed: 0x%x\n", (unsigned)program_result.error());
        return -1;
    }
    Program &program = program_result.get();

    printf("ExecuTorch program loaded successfully (%u bytes)\n",
           (unsigned)sizeof(model_pte));
    printf("Number of methods: %u\n", (unsigned)program.num_methods());

    /* Query the "forward" method metadata */
    Result<MethodMeta> method_meta = program.method_meta("forward");
    if (!method_meta.ok()) {
        printf("method_meta(\"forward\") failed: 0x%x\n",
               (unsigned)method_meta.error());
        return -1;
    }

    printf("Method 'forward': %u inputs, %u outputs\n",
           (unsigned)method_meta->num_inputs(),
           (unsigned)method_meta->num_outputs());

    printf("Inference setup complete.\n");
    return 0;
}
```

## src/model_pte.h
```c
/* Dummy model for proof-of-concept build. Replace with real .pte export. */
__attribute__((section("network_model_sec"), aligned(16))) char model_pte[] = {
0x00, 0x00, 0x00, 0x00
};
```
